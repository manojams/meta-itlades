## base/conf/local.conf
```bitbake
#MACHINE ??= 'icoremx6solo'
MACHINE = 'italdesicorem6solo'
DISTRO ?= 'fslc-framebuffer'

#bug workaround
PACKAGE_CLASSES = "package_rpm"
#PACKAGE_CLASSES = "package_ipk"

#DNF REPO CONFIGURATION
PACKAGE_FEED_URIS = "http://192.168.12.40/italdes-rpm/"

#enable incrementing package revision number
PRSERV_HOST = "localhost:0"

#NTC
DEFAULT_TIMEZONE = "Europe/Paris"

#REMOVE EXTRA STUFF
MACHINE_FEATURES_remove = "bluetooth dbus usbgadget wifi qemu-usermode usbgadget"
DISTRO_FEATURES_remove = "bluez5 bluetooth irda pcmcia wifi nfc usbgadget irda zeroconf ipv6 "

#not sure if it is necessary
PACKAGECONFIG_FONTS_append_pn-qtbase = " fontconfig"
PACKAGECONFIG_append_pn-qtmultimedia = " gstreamer"

PACKAGECONFIG_append_pn-pulseaudio = " libpulse-mainloop-glib"


#EXTRA_IMAGE_FEATURES ?= "debug-tweaks  package-management"
CORE_IMAGE_EXTRA_INSTALL += " openssh"

USER_CLASSES ?= "buildstats image-mklibs image-prelink"
PATCHRESOLVE = "noop"
BB_DISKMON_DIRS = "\
    STOPTASKS,${TMPDIR},1G,100K \
    STOPTASKS,${DL_DIR},1G,100K \
    STOPTASKS,${SSTATE_DIR},1G,100K \
    STOPTASKS,/tmp,100M,100K \
    ABORT,${TMPDIR},100M,1K \
    ABORT,${DL_DIR},100M,1K \
    ABORT,${SSTATE_DIR},100M,1K \
    ABORT,/tmp,10M,1K"
#PACKAGECONFIG_append_pn-qemu-native = " sdl"
#PACKAGECONFIG_append_pn-nativesdk-qemu = " sdl"
CONF_VERSION = "1"

BB_NUMBER_THREADS = '6'
PARALLEL_MAKE = '-j 6'

DL_DIR ?= "${BSPDIR}/downloads/"

UBOOT_CONFIG="sd"

PACKAGECONFIG_append_pn-qtbase = " tslib "
PACKAGECONFIG_append_pn-qtbase = " linuxfb "
PACKAGECONFIG_append_pn-qtbase = " fontconfig "

IMAGE_ROOTFS_SIZE = "2097152"
DISTRO_FEATURES_remove = " x11 wayland"
STARTUPDEMO = "resistive"
ACCEPT_FSL_EULA = "1"


PACKAGECONFIG_append = " sql-sqlite "

#LOLLO aggiunto il 19-01-2018 per GStreamer su suggerimento di Domenico
LICENSE_FLAGS_WHITELIST = "commercial"

#LOLLO aggiunto suggerito in Rete
PACKAGECONFIG_remove_pn-gstreamer1.0-plugins-good = " gdk-pixbuf "

#added by hob
IMAGE_FSTYPES = "tar.bz2 ext4 sdcard ubifs"
#added by hob
SDKMACHINE = "x86_64"
```

## conf/machine/italdesicorem6solo.conf
```bitbake
#@TYPE: Machine
#@NAME: engicam iCoreMx6 solo
#@SOC: i.MX6DL
#@DESCRIPTION: Machine configuration for Engicam iCoreM6 solo

include conf/machine/include/iCoreM6.inc

MACHINEOVERRIDES =. "mx6:mx6dl:icoremx6:"

KERNEL_DEVICETREE = " icorem6dl-italdes.dtb"

KERNEL_DEFCONFIG = "icoremx6_defconfig"

KERNEL_IMAGETYPE = "uImage"

SPL_BINARY = "SPL"
UBOOT_SUFFIX = "img"
UBOOT_CONFIG ??= "nand sd"
UBOOT_CONFIG[sd] = "imx6qdl_icore_mmc_config,sd"
UBOOT_CONFIG[nand] = "imx6dl_icore_nand_config,nand"
UBOOT_ENTRYPOINT = "0x10008000"
UBOOT_LOADADDRESS = "0x10008000"
```
